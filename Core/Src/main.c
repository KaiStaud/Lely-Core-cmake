/* USER CODE BEGIN Header */
/**
 ******************************************************************************
 * @file           : main.c
 * @brief          : Main program body
 ******************************************************************************
 * @attention
 *
 * Copyright (c) 2026 STMicroelectronics.
 * All rights reserved.
 *
 * This software is licensed under terms that can be found in the LICENSE file
 * in the root directory of this software component.
 * If no LICENSE file comes with this software, it is provided AS-IS.
 *
 ******************************************************************************
 */
/* USER CODE END Header */
/* Includes ------------------------------------------------------------------*/
#include "main.h"
#include "dma.h"
#include "fdcan.h"
#include "rtc.h"
#include "spi.h"
#include "tim.h"
#include "usart.h"
#include "gpio.h"

/* Private includes ----------------------------------------------------------*/
/* USER CODE BEGIN Includes */
#include <lely/co/co.h>
#include <lely/co/nmt.h>
#include <lely/co/rpdo.h>
#include <lely/co/sdev.h>
#include <lely/co/sdo.h>
#include <lely/co/time.h>
#include <lely/co/tpdo.h>
#include <lely/can/net.h>

#include "../bsp/can.h"
#include <stdlib.h>
/* USER CODE END Includes */

/* Private typedef -----------------------------------------------------------*/
/* USER CODE BEGIN PTD */

/* USER CODE END PTD */

/* Private define ------------------------------------------------------------*/
/* USER CODE BEGIN PD */
#include <lely/util/diag.h>
#define trace(...) \
	diag_at(DIAG_DEBUG, 0, &(struct floc){ __FILE__, __LINE__, 0 }, \
			__VA_ARGS__)
/* USER CODE END PD */

/* Private macro -------------------------------------------------------------*/
/* USER CODE BEGIN PM */

/* USER CODE END PM */

/* Private variables ---------------------------------------------------------*/

/* USER CODE BEGIN PV */
struct timespec now = { 0, 0 };
struct timespec last_tp = { 0, 0 };

co_nmt_t *nmt;
can_net_t *net;
// Generated by `dcf2c --no-strings lpc17xx.dcf lpc17xx_sdev -o src/sdev.c`
extern const struct co_sdev lpc17xx_sdev;

/* USER CODE END PV */

/* Private function prototypes -----------------------------------------------*/
void SystemClock_Config(void);
/* USER CODE BEGIN PFP */
static int on_can_send(const struct can_msg *msg, void *data);
static void on_nmt_cs(co_nmt_t *nmt, co_unsigned8_t cs, void *data);
static void on_time(co_time_t *time, const struct timespec *tp, void *data);
static co_unsigned32_t on_dn_2000_00(co_sub_t *sub, struct co_sdo_req *req,
		void *data);
static co_unsigned32_t on_up_2001_00(const co_sub_t *sub,
		struct co_sdo_req *req, void *data);

// dn : master to slave
// up : slave to master

/* USER CODE END PFP */

/* Private user code ---------------------------------------------------------*/
/* USER CODE BEGIN 0 */

/* USER CODE END 0 */

/**
  * @brief  The application entry point.
  * @retval int
  */
int main(void)
{

  /* USER CODE BEGIN 1 */

  /* USER CODE END 1 */

  /* MCU Configuration--------------------------------------------------------*/

  /* Reset of all peripherals, Initializes the Flash interface and the Systick. */
  HAL_Init();

  /* USER CODE BEGIN Init */

  /* USER CODE END Init */

  /* Configure the system clock */
  SystemClock_Config();

  /* USER CODE BEGIN SysInit */

  /* USER CODE END SysInit */

  /* Initialize all configured peripherals */
  MX_GPIO_Init();
  MX_DMA_Init();
  MX_FDCAN1_Init();
  MX_TIM17_Init();
  MX_USART2_UART_Init();
  MX_RTC_Init();
  MX_TIM2_Init();
  MX_SPI1_Init();
  /* USER CODE BEGIN 2 */
  can_init(125);
  HAL_UART_Transmit(&huart2,"Hello World",29,0);
  trace("Welcome to VSCode-Lely-CiA-402-Tester!");
  // Initialize the CAN network interface.
  net = can_net_create();
  assert(net);
  can_net_set_send_func(net, &on_can_send, NULL);
  clock_gettime(1, &now);
  can_net_set_time(net, &now);

  	co_dev_t *dev = co_dev_create_from_sdev(&lpc17xx_sdev);
  assert(dev);

  nmt = co_nmt_create(net, dev);
  assert(nmt);
  co_nmt_cs_ind(nmt, CO_NMT_CS_RESET_NODE);
  co_nmt_set_cs_ind(nmt, &on_nmt_cs, NULL);
  co_time_set_ind(co_nmt_get_time(nmt), &on_time, NULL);

  // Set the download (SDO write) indication function for sub-object 2000:01.
  co_sub_set_dn_ind(co_dev_find_sub(dev, 0x2000, 0x00), &on_dn_2000_00, NULL);
  // Set the upload (SDO read) indication function for sub-object 2001:01.
  co_sub_set_up_ind(co_dev_find_sub(dev, 0x2001, 0x00), &on_up_2001_00, NULL);
  //	co_sub_set_up_ind(co_dev_find_sub(dev,0x60FD,0x00),&on_up_60FD_00,NULL);
  //	  co_nmt_on_sync(nmt, 1);
  //co_nmt_set_sync_ind(nmt, sync_indication, NULL);
  co_tpdo_t* tpdo_1 = co_tpdo_create(net, dev, 1);
  if (tpdo_1 == NULL) {
    //trace("tdpo 1 not created");
  }
  co_rpdo_t* rpdo_1 = co_rpdo_create(net, dev, 1);
  if (rpdo_1 == NULL) {
    //trace("rdpo 1 not created");
  }

  if (co_tpdo_start(tpdo_1) != 0) {
    //trace("could not start tpdo");
  }
  if (co_rpdo_start(rpdo_1) != 0) {
    //trace("could not start rpdo");
  }
  //trace("Press PB1 to continue to start CanOpen loop");
  //trace("Sending dummy data [7F 12 34");
  while (!HAL_GPIO_ReadPin(B1_GPIO_Port, B1_Pin)) {
    struct can_msg msg;
    msg.len = 2;
    msg.data[1] = 0x12;
    msg.data[2] = 0x34;
    can_send(&msg, 3);
    HAL_Delay(500);
    //HAL_GPIO_TogglePin(LED_GPIO_Port, LED_Pin);

    // Disable Interrupt an poll can rx buffer
  }
  //trace("Running CANOpen Application");

  /* USER CODE END 2 */

  /* Infinite loop */
  /* USER CODE BEGIN WHILE */
  while (1) {
    clock_gettime(1, &now);
    localtime(&now.tv_sec);

    RTC_DateTypeDef gDate;
    RTC_TimeTypeDef gTime;
    // gTime.Hours gTime.Seconds
    HAL_RTC_GetTime(&hrtc, &gTime, RTC_FORMAT_BIN);
    HAL_RTC_GetDate(&hrtc, &gDate, RTC_FORMAT_BIN);

    // //trace("%02d:%02d:%02d",gTime.Hours, gTime.Minutes, gTime.Seconds);

    if ((last_tp.tv_sec == now.tv_sec) && (last_tp.tv_nsec == now.tv_nsec)) {
      // //trace("clock did not progressed %lu:%lu",now.tv_sec,now.tv_nsec);
    }
    can_net_set_time(net, &now);

    last_tp.tv_nsec = now.tv_nsec;
    last_tp.tv_sec = now.tv_sec;
    // Process any received CAN frames.
    struct can_msg msg;
    int n_frames = can_recv(&msg, 1);
    if (n_frames != 0) {
      can_net_recv(net, &msg);
      //HAL_GPIO_TogglePin(LED_GPIO_Port, LED_Pin);
    }
    //set_statusword(dev);
    //try_homing(dev);
    HAL_Delay(1);
    /* USER CODE END WHILE */

    /* USER CODE BEGIN 3 */
  }
  /* USER CODE END 3 */
}

/**
  * @brief System Clock Configuration
  * @retval None
  */
void SystemClock_Config(void)
{
  RCC_OscInitTypeDef RCC_OscInitStruct = {0};
  RCC_ClkInitTypeDef RCC_ClkInitStruct = {0};

  /** Configure the main internal regulator output voltage
  */
  HAL_PWREx_ControlVoltageScaling(PWR_REGULATOR_VOLTAGE_SCALE1);

  /** Initializes the RCC Oscillators according to the specified parameters
  * in the RCC_OscInitTypeDef structure.
  */
  RCC_OscInitStruct.OscillatorType = RCC_OSCILLATORTYPE_HSI|RCC_OSCILLATORTYPE_LSI;
  RCC_OscInitStruct.HSIState = RCC_HSI_ON;
  RCC_OscInitStruct.HSICalibrationValue = RCC_HSICALIBRATION_DEFAULT;
  RCC_OscInitStruct.LSIState = RCC_LSI_ON;
  RCC_OscInitStruct.PLL.PLLState = RCC_PLL_ON;
  RCC_OscInitStruct.PLL.PLLSource = RCC_PLLSOURCE_HSI;
  RCC_OscInitStruct.PLL.PLLM = RCC_PLLM_DIV1;
  RCC_OscInitStruct.PLL.PLLN = 21;
  RCC_OscInitStruct.PLL.PLLP = RCC_PLLP_DIV2;
  RCC_OscInitStruct.PLL.PLLQ = RCC_PLLQ_DIV2;
  RCC_OscInitStruct.PLL.PLLR = RCC_PLLR_DIV2;
  if (HAL_RCC_OscConfig(&RCC_OscInitStruct) != HAL_OK)
  {
    Error_Handler();
  }

  /** Initializes the CPU, AHB and APB buses clocks
  */
  RCC_ClkInitStruct.ClockType = RCC_CLOCKTYPE_HCLK|RCC_CLOCKTYPE_SYSCLK
                              |RCC_CLOCKTYPE_PCLK1|RCC_CLOCKTYPE_PCLK2;
  RCC_ClkInitStruct.SYSCLKSource = RCC_SYSCLKSOURCE_PLLCLK;
  RCC_ClkInitStruct.AHBCLKDivider = RCC_SYSCLK_DIV2;
  RCC_ClkInitStruct.APB1CLKDivider = RCC_HCLK_DIV1;
  RCC_ClkInitStruct.APB2CLKDivider = RCC_HCLK_DIV1;

  if (HAL_RCC_ClockConfig(&RCC_ClkInitStruct, FLASH_LATENCY_2) != HAL_OK)
  {
    Error_Handler();
  }
}

/* USER CODE BEGIN 4 */
static int on_can_send(const struct can_msg* msg, void* data) {
  (void)data;
  struct timespec tp;
  clock_gettime(1, &tp);
  //trace("send frame %lu:%lu", tp.tv_sec, tp.tv_nsec);
  return can_send(msg, 1) == 1 ? 0 : -1;
}

static void on_nmt_cs(co_nmt_t* nmt, co_unsigned8_t cs, void* data) {
  (void)data;

  switch (cs) {
    case CO_NMT_CS_START:
      // Reset the TIME indication function, since the service may
      // have been restarted.
      co_time_set_ind(co_nmt_get_time(nmt), &on_time, NULL);
      break;
    case CO_NMT_CS_STOP:
      break;
    case CO_NMT_CS_ENTER_PREOP:
      co_time_set_ind(co_nmt_get_time(nmt), &on_time, NULL);
      break;
    case CO_NMT_CS_RESET_NODE:
      // Initiate a system reset.
      exit(0);
      break;
    case CO_NMT_CS_RESET_COMM:
      break;
  }
}

static void on_time(co_time_t* time, const struct timespec* tp, void* data) {
  (void)time;
  (void)data;

  // Update the wall clock, _not_ the monotonic clock used by the CAN
  // network.
  clock_settime(CLOCK_REALTIME, tp);
}

static co_unsigned32_t on_dn_2000_00(co_sub_t* sub, struct co_sdo_req* req,
                                     void* data) {
  assert(sub);
  assert(co_obj_get_idx(co_sub_get_obj(sub)) == 0x2000);
  assert(co_sub_get_subidx(sub) == 0x00);
  assert(req);
  // The data pointer can be used to pass user-specified data to the
  // callback function. It is the last argument passed to
  // co_sub_set_dn_ind().
  (void)data;

  co_unsigned32_t ac = 0;

  co_unsigned16_t type = co_sub_get_type(sub);  // dd
  assert(type == CO_DEFTYPE_UNSIGNED32);

  // This callback is invoked for every SDO CAN frame. Unless the value is
  // too large to be held in memory (for example, during a firmware
  // update), it is more convenient to wait until the entire value is
  // received. This is what the following call is designed to do. It
  // returns -1 with ac == 0 if more CAN frames are pending.
  union co_val val;
  if (co_sdo_req_dn_val(req, type, &val, &ac) == -1) return ac;

  // Write the temporary value to the local object dictionary.
  /*
  co_sub_dn(sub, &val);
  //trace("Received SDO 0x2000:0 : val.u32=[%lu]", val.u32);
  run_transition(val.u32);
  //trace("Drive state = %d, Statusword = %X", get_state(),
        get_statusword_lowbyte(get_state()));
  */
  // Finalize the temporary value. This is only necessary to cleanup array
  // values, but it is a good practice to always include it.
  co_val_fini(type, &val);
  return ac;
}
/*
static co_unsigned32_t
on_up_2001_00(const co_sub_t *sub, struct co_sdo_req *req, void *data)
{
        assert(co_obj_get_idx(co_sub_get_obj(sub)) == 0x2001);
        assert(co_sub_get_subidx(sub) == 0x00);
        assert(req);
        (void)data;

        co_unsigned16_t type = co_sub_get_type(sub);
        assert(type == CO_DEFTYPE_UNSIGNED32);

        // TODO: Obtain value from somewhere.
        co_unsigned32_t val = 42;

        // Store the value in the send buffer.
        co_unsigned32_t ac = 0;
        co_sdo_req_up_val(req, type, &val, &ac);
        return ac;
}
*/
static co_unsigned32_t on_up_2001_00(const co_sub_t* sub,
                                     struct co_sdo_req* req, void* data) {
  assert(req);
  (void)data;

  co_unsigned16_t type = co_sub_get_type(sub);

  co_unsigned32_t val = 0;//co_hal_read_digital_inputs();

  // Store the value in the send buffer.
  co_unsigned32_t ac = 0;
  co_sdo_req_up_val(req, type, &val, &ac);
  return ac;
}

/* USER CODE END 4 */

/**
  * @brief  Period elapsed callback in non blocking mode
  * @note   This function is called  when TIM16 interrupt took place, inside
  * HAL_TIM_IRQHandler(). It makes a direct call to HAL_IncTick() to increment
  * a global variable "uwTick" used as application time base.
  * @param  htim : TIM handle
  * @retval None
  */
void HAL_TIM_PeriodElapsedCallback(TIM_HandleTypeDef *htim)
{
  /* USER CODE BEGIN Callback 0 */

  /* USER CODE END Callback 0 */
  if (htim->Instance == TIM16)
  {
    HAL_IncTick();
  }
  /* USER CODE BEGIN Callback 1 */

  /* USER CODE END Callback 1 */
}

/**
  * @brief  This function is executed in case of error occurrence.
  * @retval None
  */
void Error_Handler(void)
{
  /* USER CODE BEGIN Error_Handler_Debug */
  /* User can add his own implementation to report the HAL error return state */
  __disable_irq();
  while (1) {
  }
  /* USER CODE END Error_Handler_Debug */
}
#ifdef USE_FULL_ASSERT
/**
  * @brief  Reports the name of the source file and the source line number
  *         where the assert_param error has occurred.
  * @param  file: pointer to the source file name
  * @param  line: assert_param error line source number
  * @retval None
  */
void assert_failed(uint8_t *file, uint32_t line)
{
  /* USER CODE BEGIN 6 */
  /* User can add his own implementation to report the file name and line
     number, ex: printf("Wrong parameters value: file %s on line %d\r\n", file,
     line) */
  /* USER CODE END 6 */
}
#endif /* USE_FULL_ASSERT */
